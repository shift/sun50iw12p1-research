## configs/hy300_h713_defconfig
```kconfig
# HY300 H713 Projector U-Boot Configuration
# Based on H6 platform with USB serial gadget support for console access

# ARM64 and Sunxi Platform
CONFIG_ARM=y
CONFIG_ARCH_SUNXI=y
CONFIG_DEFAULT_DEVICE_TREE="sun50i-h713-hy300"
CONFIG_SPL=y
CONFIG_MACH_SUN50I_H6=y

# DRAM Configuration (DDR3-1600 from boot0 analysis)
CONFIG_SUNXI_DRAM_H6_DDR3=y
CONFIG_DRAM_CLK=792
CONFIG_DRAM_ZQ=3881977

# Storage Support
CONFIG_MMC=y
CONFIG_MMC_SUNXI=y
CONFIG_MMC0_CD_PIN=""
CONFIG_SUPPORT_EMMC_BOOT=y

# USB Host Support
CONFIG_USB=y
CONFIG_USB_XHCI_HCD=y
CONFIG_USB_XHCI_DWC3=y
CONFIG_USB_EHCI_HCD=y
CONFIG_USB_OHCI_HCD=y
CONFIG_USB_DWC3=y

# USB Gadget Support for Serial Console
CONFIG_USB_GADGET=y
CONFIG_USB_GADGET_DWC2_OTG=y
CONFIG_USB_GADGET_DOWNLOAD=y
CONFIG_USB_FUNCTION_MASS_STORAGE=y
CONFIG_USB_FUNCTION_ACM=y
CONFIG_CMD_USB_MASS_STORAGE=y

# USB Serial Console (CDC ACM)
CONFIG_DM_USB_GADGET=y
CONFIG_USB_GADGET_MANUFACTURER="Allwinner"
CONFIG_USB_GADGET_VENDOR_NUM=0x1f3a
CONFIG_USB_GADGET_PRODUCT_NUM=0x1010

# Environment and Boot
CONFIG_ENV_IS_IN_MMC=y
CONFIG_SYS_MMC_ENV_DEV=0

# Console Configuration
CONFIG_CONSOLE_MUX=y

# PSCI Power Management
# CONFIG_PSCI_RESET is not set

# Disable malloc clear for faster boot
# CONFIG_SYS_MALLOC_CLEAR_ON_INIT is not set

# Command Support
CONFIG_CMD_GPIO=y
CONFIG_CMD_I2C=y
CONFIG_CMD_MMC=y
CONFIG_CMD_USB=y

# Device Drivers
CONFIG_DM=y
CONFIG_DM_GPIO=y
CONFIG_DM_I2C=y
CONFIG_DM_MMC=y
CONFIG_DM_SERIAL=y

# Serial Console (UART0)
CONFIG_CONS_INDEX=1
CONFIG_BAUDRATE=115200
```

## configs/hy300_kernel_defconfig
```kconfig
# HY300 Minimal Kernel Configuration
# Based on ARM64 defconfig with Sunxi-specific additions

CONFIG_ARM64=y
CONFIG_ARCH_SUNXI=y
CONFIG_MACH_SUN50I=y

# Device Tree
CONFIG_OF=y
CONFIG_OF_FLATTREE=y
CONFIG_OF_OVERLAY=y
CONFIG_OF_CONFIGFS=y

# Boot and storage
CONFIG_MMC=y
CONFIG_MMC_SUNXI=y
CONFIG_MMC_BLOCK=y
CONFIG_EXT4_FS=y
CONFIG_VFAT_FS=y
CONFIG_FAT_FS=y

# Serial console
CONFIG_SERIAL_8250=y
CONFIG_SERIAL_8250_CONSOLE=y
CONFIG_SERIAL_8250_DW=y
CONFIG_SERIAL_OF_PLATFORM=y

# GPIO and pinctrl
CONFIG_PINCTRL=y
CONFIG_PINCTRL_SUNXI=y
CONFIG_GPIOLIB=y
CONFIG_GPIO_SYSFS=y

# Clock framework
CONFIG_COMMON_CLK=y
CONFIG_CLK_SUNXI=y

# Basic file systems
CONFIG_PROC_FS=y
CONFIG_SYSFS=y
CONFIG_TMPFS=y
CONFIG_DEVTMPFS=y
CONFIG_DEVTMPFS_MOUNT=y

# Network
CONFIG_NET=y
CONFIG_PACKET=y
CONFIG_UNIX=y
CONFIG_INET=y

# Media support
CONFIG_MEDIA_SUPPORT=y
CONFIG_MEDIA_CAMERA_SUPPORT=y
CONFIG_MEDIA_ANALOG_TV_SUPPORT=y
CONFIG_MEDIA_PLATFORM_SUPPORT=y
CONFIG_MEDIA_PLATFORM_DRIVERS=y
CONFIG_V4L_PLATFORM_DRIVERS=y
CONFIG_VIDEO_DEV=y
CONFIG_VIDEO_V4L2=y
CONFIG_VIDEOBUF2_CORE=y
CONFIG_VIDEOBUF2_DMA_CONTIG=y
CONFIG_V4L2_MEM2MEM_DEV=y

# Reset controller support
CONFIG_RESET_CONTROLLER=y

# HY300 Custom drivers (as modules)
CONFIG_SUNXI_NSI=m
CONFIG_SUNXI_MIPSLOADER=m
CONFIG_SUNXI_TVTOP=m
CONFIG_SUNXI_CPU_COMM=m
CONFIG_HY300_KEYSTONE_MOTOR=m
CONFIG_VIDEO_SUNXI_TVCAP=m

# CRC32 support (required by NSI drivers)
CONFIG_CRC32=y

# Additional media platform configs to prevent prompts
CONFIG_SDR_PLATFORM_DRIVERS=y
CONFIG_DVB_PLATFORM_DRIVERS=n
CONFIG_V4L_MEM2MEM_DRIVERS=y
```

## configs/sun50i-h713-hy300_defconfig
```kconfig
CONFIG_TARGET_SUN50I_H713_HY300=y
CONFIG_ARCH_SUNXI=y
CONFIG_DEFAULT_DEVICE_TREE="sun50i-h713-hy300"
CONFIG_SPL=y
CONFIG_MACH_SUN50I_H713=y
CONFIG_MMC0_CD_PIN=""
CONFIG_MMC_SUNXI_SLOT_EXTRA=2
CONFIG_SPL_SPI_SUNXI=y

# DRAM Configuration - Enhanced from HY300 boot0.bin + FEX files
CONFIG_DRAM_CLK=640
CONFIG_DRAM_TYPE=3
CONFIG_DRAM_ZQ=0x7b7bfb
CONFIG_DRAM_ODT_EN=1
# Mode registers from FEX
CONFIG_DRAM_MR0=0x1c70
CONFIG_DRAM_MR1=0x40
CONFIG_DRAM_MR2=0x18
CONFIG_DRAM_MR3=0x0
# Enhanced timing parameters from FEX
CONFIG_DRAM_TPR0=0x004A2195
CONFIG_DRAM_TPR1=0x02423190
CONFIG_DRAM_TPR2=0x0008B061
CONFIG_DRAM_TPR3=0xB4787896
CONFIG_DRAM_TPR4=0x0
CONFIG_DRAM_TPR5=0x48484848
CONFIG_DRAM_TPR6=0x48
CONFIG_DRAM_TPR7=0x1620121e
CONFIG_DRAM_TPR8=0x0
CONFIG_DRAM_TPR9=0x0
CONFIG_DRAM_TPR10=0x0
CONFIG_DRAM_TPR11=0x44440000
CONFIG_DRAM_TPR12=0x00005555
CONFIG_DRAM_TPR13=0x34010100

# Boot Configuration
CONFIG_SPL_TEXT_BASE=0x10000
CONFIG_SYS_TEXT_BASE=0x4a000000
CONFIG_BOOTDELAY=3
CONFIG_BOOTCOMMAND="run distro_bootcmd"

# Serial Console
CONFIG_CONS_INDEX=1
CONFIG_BAUDRATE=115200

# Environment - Updated for eMMC storage
CONFIG_ENV_IS_IN_MMC=y
CONFIG_ENV_MMC_DEVICE=2
CONFIG_ENV_OFFSET=0x20000
CONFIG_ENV_SIZE=0x20000
CONFIG_SYS_REDUNDAND_ENVIRONMENT=y
CONFIG_ENV_OFFSET_REDUND=0x40000

# Partition Support - GPT for Android compatibility 
CONFIG_EFI_PARTITION=y
CONFIG_CMD_GPT=y
CONFIG_PARTITION_UUIDS=y
CONFIG_PARTITION_TYPE_GUID=y
CONFIG_CMD_PART=y
CONFIG_SPL_PARTITION_UUIDS=y

# Boot Configuration - eMMC boot support
CONFIG_BOOTCOMMAND="mmc dev 2; if mmc rescan; then if run loadbootscript; then run bootscript; else if run loadimage; then run mmcboot; else run netboot; fi; fi; else run netboot; fi"
CONFIG_EXTRA_ENV_SETTINGS="console=ttyS0,115200\0" \
	"fdt_high=0xffffffffffffffff\0" \
	"initrd_high=0xffffffffffffffff\0" \
	"kernel_addr_r=0x40080000\0" \
	"fdt_addr_r=0x4FA00000\0" \
	"scriptaddr=0x40090000\0" \
	"pxefile_addr_r=0x40200000\0" \
	"ramdisk_addr_r=0x4FE00000\0" \
	"boot_targets=mmc2 mmc0 mmc1 usb0 pxe dhcp\0" \
	"mmcdev=2\0" \
	"mmcpart=9\0" \
	"mmcroot=/dev/mmcblk2p9 rootfstype=ext4 rootwait\0" \
	"mmcargs=setenv bootargs console=${console} root=${mmcroot}\0" \
	"loadbootscript=fatload mmc ${mmcdev}:${mmcpart} ${scriptaddr} boot.scr\0" \
	"bootscript=echo Running bootscript from mmc${mmcdev} ...; source ${scriptaddr}\0" \
	"loadimage=fatload mmc ${mmcdev}:${mmcpart} ${kernel_addr_r} zImage\0" \
	"loadfdt=fatload mmc ${mmcdev}:${mmcpart} ${fdt_addr_r} sun50i-h713-hy300.dtb\0" \
	"mmcboot=echo Booting from mmc${mmcdev} ...; run mmcargs; if run loadfdt; then bootz ${kernel_addr_r} - ${fdt_addr_r}; else echo WARN: Cannot load the DT; fi\0" \
	"netboot=echo Booting from net ...; run netargs; if tftpboot ${kernel_addr_r} zImage; then if tftpboot ${fdt_addr_r} sun50i-h713-hy300.dtb; then bootz ${kernel_addr_r} - ${fdt_addr_r}; else echo WARN: Cannot load the DT; fi; fi\0"

# Networking
CONFIG_NETDEVICES=y

# USB Support - Enabled for hardware deployment
CONFIG_USB=y
CONFIG_DM_USB=y
CONFIG_USB_EHCI_HCD=y
CONFIG_USB_EHCI_SUNXI=y
CONFIG_USB_OHCI_HCD=y
CONFIG_USB_OHCI_SUNXI=y
CONFIG_USB_STORAGE=y
CONFIG_USB_KEYBOARD=y
CONFIG_CMD_USB=y
CONFIG_USB_HOST=y
CONFIG_SYS_USB_EHCI_MAX_ROOT_PORTS=1

# Storage - eMMC specific configuration
CONFIG_MMC=y
CONFIG_MMC_SUNXI=y
CONFIG_SPL_MMC_SUPPORT=y
CONFIG_MMC_HS400_SUPPORT=y
CONFIG_MMC_HS200_SUPPORT=y
CONFIG_MMC_WRITE=y
CONFIG_CMD_MMC=y

# Additional eMMC slot configuration (for boot from eMMC)
CONFIG_MMC_SUNXI_SLOT_EXTRA=2

# FEL Mode Support
CONFIG_SPL_FEL=y

# Device Tree
CONFIG_OF_BOARD_FIXUP=y

# HDMI Display Support - Enabled for hardware deployment

CONFIG_DM_VIDEO=y
CONFIG_VIDEO=y
CONFIG_DISPLAY=y
CONFIG_VIDEO_SUNXI=y
CONFIG_VIDEO_DE2=y
CONFIG_VIDEO_HDMI=y
CONFIG_HDMI_SUNXI=y
CONFIG_VIDEO_BPP32=y
CONFIG_SYS_WHITE_ON_BLACK=y
CONFIG_CONSOLE_MUX=y
CONFIG_VIDEO_ANSI=y

# Debug
CONFIG_LOGLEVEL=7
CONFIG_SPL_LOGLEVEL=7
```

## drivers/media/platform/sunxi/Kconfig
```kconfig
# SPDX-License-Identifier: GPL-2.0-only

config VIDEO_SUNXI_TVCAP
	tristate "Allwinner TV Capture V4L2 Driver"
	depends on VIDEO_DEV && ARCH_SUNXI
	depends on COMMON_CLK && RESET_CONTROLLER
	select VIDEOBUF2_DMA_CONTIG
	select V4L2_MEM2MEM_DEV
	help
	  Support for Allwinner H713 TV capture interface for HDMI input.
	  This driver provides V4L2 video capture device for HDMI input
	  signal capture with MIPS co-processor coordination.

	  This driver is specifically designed for the HY300 Android projector
	  hardware with H713 SoC and implements TV capture functionality
	  based on comprehensive factory firmware analysis.

	  To compile this driver as a module, choose M here: the module
	  will be called sunxi-tvcap.
source "drivers/media/platform/sunxi/sun50i-h713-av1/Kconfig"
```

## drivers/misc/Kconfig
```kconfig
# SPDX-License-Identifier: GPL-2.0-only
#
# HY300 Projector Misc Drivers
#

config SUNXI_MIPSLOADER
	tristate "Allwinner MIPS Co-processor Loader"
	depends on ARCH_SUNXI
	help
	  Support for Allwinner MIPS co-processor loader driver
	  for H713 SoC. The MIPS co-processor handles display
	  engine control and projector-specific hardware management.

config SUNXI_NSI
	tristate "Allwinner Network Service Interface"
	depends on ARCH_SUNXI
	select CRC32
	help
	  Support for Allwinner Network Service Interface (NSI) driver
	  for ARM-MIPS communication in H713 SoC. Provides shared memory
	  management and interrupt-driven command/response protocol.

config SUNXI_CPU_COMM
	tristate "Allwinner CPU Communication Interface"
	depends on ARCH_SUNXI && SUNXI_NSI
	select CRC32
	help
	  Support for Allwinner CPU Communication Interface driver
	  for ARM-MIPS high-level communication in H713 SoC. Provides
	  HDMI input control, EDID reading, format negotiation, and
	  capture buffer management through MIPS co-processor.

config HY300_KEYSTONE_MOTOR
	tristate "HY300 Keystone Motor Control"
	depends on ARCH_SUNXI
	help
	  Support for HY300 projector keystone motor control.
	  Provides hardware interface for projector lens adjustment
	  and automatic keystone correction.
```
